# file: practica_2.ioc
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Mcu.Family=STM32F4
RCC.VCOOutputFreq_Value=192000000
RCC.CortexFreq_Value=16000000
Mcu.Name=STM32F446R(C-E)Tx
Mcu.Package=LQFP64
ProjectManager.StackSize=0x400
PA5.GPIO_Label=LD2 [Green Led]
ProjectManager.HeapSize=0x200
ProjectManager.TargetToolchain=STM32CubeIDE
NVIC.PriorityGroup=NVIC_PRIORITYGROUP_4
RCC.USBFreq_Value=96000000
PA5.Signal=GPIO_Output
board=custom

// file: Core/Src/main.c
/* USER CODE BEGIN Header */
/**
  ******************************************************************************
  * @file           : main.c
  * @brief          : Main program body
  ******************************************************************************
  * @attention
  *
  * <h2><center>&copy; Copyright (c) 2025 STMicroelectronics.
  * All rights reserved.</center></h2>
  *
  * This software component is licensed by ST under BSD 3-Clause license,
  * the "License"; You may not use this file except in compliance with the
  * License. You may obtain a copy of the License at:
  *                        opensource.org/licenses/BSD-3-Clause
  *
  *
  *Punto 1

		Crear un nuevo proyecto como copia del proyecto realizado para la práctica 2.
		Crear una carpeta API dentro de la carpeta Drivers en la estructura de directorios del nuevo proyecto. Crear dentro de la carpeta API, subcarpetas /Src y /Inc.
		Encapsular las funciones necesarias para usar retardos no bloqueantes en un archivo fuente API_delay.c con su correspondiente archivo de cabecera API_delay.h, y ubicar estos archivos en la carpeta API creada.

		En API_delay.h se deben ubicar los prototipos de las funciones y declaraciones

		typedef uint32_t tick_t; // Qué biblioteca se debe incluir para que esto compile?
		typedef bool bool_t;	  // Qué biblioteca se debe incluir para que esto compile?
		typedef struct{
		   tick_t startTime;
		   tick_t duration;
		   bool_t running;
		} delay_t;
		void delayInit( delay_t * delay, tick_t duration );
		bool_t delayRead( delay_t * delay );
		void delayWrite( delay_t * delay, tick_t duration );

		En API_delay.c se deben ubicar la implementación de todas las funciones.
		nota: cuando se agregar carpetas a un proyecto de eclipse se deben incluir en el include path para que se incluya su contenido en la compilación.  Se debe hacer clic derecho sobre la carpeta con los archivos de encabezamiento y seleccionar la opción add/remove include path.

	Punto 2

		Implementar un programa que utilice retardos no bloqueantes y haga titilar en forma periódica un led de la placa NUCLEO-F4xx de acuerdo a una secuencia predeterminada:

		const uint32_t TIEMPOS[] = {500, 100, 100, 1000};
		Utilizar la función delayWrite y una única variable tipo delay_t para cambiar el tiempo de encendido del led.
		NOTA: los tiempos indicados son de encendido y el led debe trabajar con duty = 50%

	Punto 3

		Implementar la siguiente función auxiliar pública en API_delay.c

		bool_t delayIsRunning(delay_t * delay);

		Esta función debe devolver una copia del valor del campo running de la estructura delay_t

		Utilizar esta función en el código implementado para el punto dos para verificar que el delay no esté corriendo antes de cambiar su valor con delayWrite.

  *
  *
  *
  *
  ******************************************************************************
  */
/* USER CODE END Header */
#include "main.h"

/* USER CODE BEGIN Includes */

#include "API_delay.h"

/* USER CODE END Includes */

void SystemClock_Config(void);
static void MX_GPIO_Init(void);

int main(void)
{

  /* MCU Configuration--------------------------------------------------------*/

  /* Reset of all peripherals, Initializes the Flash interface and the Systick. */
  HAL_Init();

  /* Configure the system clock */
  SystemClock_Config();

  /* Initialize all configured peripherals */
  MX_GPIO_Init();
  /* USER CODE BEGIN 2 */

  //Definicion de tiempos del led encendido
  const uint32_t TIEMPOS[] = {500, 100, 100, 1000};

  uint8_t cantTiempos = sizeof(TIEMPOS) / sizeof(TIEMPOS[0]);
  uint8_t indice = 0;

  delay_t delay;
  bool ledState = false;

  //Inicializacion del delay.
  delayInit(&delay, TIEMPOS[indice]);

  /* USER CODE END 2 */

  /* Infinite loop */
  /* USER CODE BEGIN WHILE */
  while (1)
  {

	if (delayRead(&delay)){

		ledState = !ledState;
		HAL_GPIO_WritePin(LD2_GPIO_Port, LD2_Pin, ledState ? GPIO_PIN_SET : GPIO_PIN_RESET);

		indice ++;

		if (indice >= cantTiempos) {
			indice = 0;
		}

		if(delayIsRunning(&delay) == false){
			delayWrite(&delay, TIEMPOS[indice]);
		}

	}

  }

    /* USER CODE END WHILE */

  }
//}

void SystemClock_Config(void)
{
  RCC_OscInitTypeDef RCC_OscInitStruct = {0};
  RCC_ClkInitTypeDef RCC_ClkInitStruct = {0};

  /** Configure the main internal regulator output voltage
  */
  __HAL_RCC_PWR_CLK_ENABLE();
  __HAL_PWR_VOLTAGESCALING_CONFIG(PWR_REGULATOR_VOLTAGE_SCALE3);
  /** Initializes the RCC Oscillators according to the specified parameters
  * in the RCC_OscInitTypeDef structure.
  */
  RCC_OscInitStruct.OscillatorType = RCC_OSCILLATORTYPE_HSI;
  RCC_OscInitStruct.HSIState = RCC_HSI_ON;
  RCC_OscInitStruct.HSICalibrationValue = RCC_HSICALIBRATION_DEFAULT;
  RCC_OscInitStruct.PLL.PLLState = RCC_PLL_NONE;
  if (HAL_RCC_OscConfig(&RCC_OscInitStruct) != HAL_OK)
  {
    Error_Handler();
  }
  /** Initializes the CPU, AHB and APB buses clocks
  */
  RCC_ClkInitStruct.ClockType = RCC_CLOCKTYPE_HCLK|RCC_CLOCKTYPE_SYSCLK
                              |RCC_CLOCKTYPE_PCLK1|RCC_CLOCKTYPE_PCLK2;
  RCC_ClkInitStruct.SYSCLKSource = RCC_SYSCLKSOURCE_HSI;
  RCC_ClkInitStruct.AHBCLKDivider = RCC_SYSCLK_DIV1;
  RCC_ClkInitStruct.APB1CLKDivider = RCC_HCLK_DIV1;
  RCC_ClkInitStruct.APB2CLKDivider = RCC_HCLK_DIV1;

  if (HAL_RCC_ClockConfig(&RCC_ClkInitStruct, FLASH_LATENCY_0) != HAL_OK)
  {
    Error_Handler();
  }
}

static void MX_GPIO_Init(void)
{
  GPIO_InitTypeDef GPIO_InitStruct = {0};

  /* GPIO Ports Clock Enable */
  __HAL_RCC_GPIOA_CLK_ENABLE();

  /*Configure GPIO pin Output Level */
  HAL_GPIO_WritePin(LD2_GPIO_Port, LD2_Pin, GPIO_PIN_RESET);

  /*Configure GPIO pin : LD2_Pin */
  GPIO_InitStruct.Pin = LD2_Pin;
  GPIO_InitStruct.Mode = GPIO_MODE_OUTPUT_PP;
  GPIO_InitStruct.Pull = GPIO_NOPULL;
  GPIO_InitStruct.Speed = GPIO_SPEED_FREQ_LOW;
  HAL_GPIO_Init(LD2_GPIO_Port, &GPIO_InitStruct);

}

void Error_Handler(void)
{
  __disable_irq();
  while (1)
  {
  }
}

/************************ (C) COPYRIGHT STMicroelectronics *****END OF FILE****/
